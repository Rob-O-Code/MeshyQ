## CMakeLists.txt
```
# SPDX-License-Identifier: Apache-2.0

cmake_minimum_required(VERSION 3.20.0)
find_package(Zephyr REQUIRED HINTS $ENV{ZEPHYR_BASE})
project(shell_test)

target_sources(app PRIVATE src/main.c)
```

## prj.conf
```kconfig
# Bisection step 1: shell/serial only. No Bluetooth, no SPI, no SD, no
# audio. Everything else is left at board defaults (same as blinky) so
# the only thing under test is the shell over USB CDC-ACM.
CONFIG_SHELL=y
CONFIG_SHELL_BACKEND_SERIAL=y
```

## boards/adafruit_feather_nrf52840_nrf52840_uf2.conf
```kconfig
# Same fix as blinky/MeshyQ: without this, Zephyr ignores the board's
# devicetree partition layout and links the app at address 0, which
# overlaps the Adafruit bootloader and bricks the board when flashed.
CONFIG_USE_DT_CODE_PARTITION=y
```

## src/main.c
```c
/*
 * Bisection step 1: confirm the shell comes up over USB CDC-ACM on the
 * Feather /uf2 target with nothing else (no BT, no SPI, no SD, no audio)
 * running. If this is stable, the next step adds Bluetooth/mesh; if that
 * one is also stable, the step after adds the SD/VS1053 code.
 */
#include <zephyr/kernel.h>
#include <zephyr/shell/shell.h>

static int cmd_ping(const struct shell *shell, size_t argc, char *argv[])
{
	shell_print(shell, "pong");
	return 0;
}

SHELL_CMD_ARG_REGISTER(ping, NULL, "Reply with pong, to confirm the shell is alive", cmd_ping, 1,
		       0);

int main(void)
{
	printk("shell_test ready\n");
	return 0;
}
```
